;迪文T5L ASIC OS 8051 核SFR接口定义

;*******************8051 核SFR****************
                $NOMOD51                
        P0		DATA	80H
	SP		DATA	81H
	DPL		DATA	82H
	DPH		DATA	83H
	PCON		DATA	87H
	TCON		DATA	88H
			TF1	BIT	TCON.7
			TR1	BIT	TCON.6
			TF0	BIT	TCON.5
			TR0	BIT	TCON.4
			IE1	BIT	TCON.3
			IT1	BIT	TCON.2
			IE0	BIT	TCON.1
			IT0	BIT	TCON.0
	TMOD		DATA	89H
	TH0		DATA	8CH
	TL0		DATA	8AH
	TH1		DATA	8DH
	TL1		DATA	8BH

	CKCON		DATA	8EH
	P1		DATA	90H

	DPC		DATA	93H
	PAGESEL		DATA	94H	;必须是0x01
	D_PAGESEL	DATA	95H	;必须是0x02

	SCON0		DATA	98H	;UART2
			TI0	BIT	SCON0.1
			RI0	BIT	SCON0.0
	SBUF0		DATA	99H
	SREL0H		DATA	0BAH
	SREL0L		DATA	0AAH

	SCON1		DATA	9BH	;UART3
	SBUF1		DATA	9CH
	SREL1H		DATA	0BBH
	SREL1L		DATA	09DH

	IEN2		DATA	9AH
	P2		DATA	0A0H
	IEN0		DATA	0A8H
		EA	BIT	IEN0.7	
                ET2     BIT     IEN0.5
                ES0     BIT     IEN0.4
                ET1     BIT     IEN0.3
		EX1	BIT	IEN0.2
                ET0     BIT     IEN0.1
		EX0	BIT	IEN0.0	

	IP0		DATA	0A9H
	P3		DATA	0B0H
	IEN1		DATA	0B8H
                ES3R    BIT     IEN1.5
                ES3T    BIT     IEN1.4
                ES2R    BIT     IEN1.3
                ES2T    BIT     IEN1.2
                ECAN    BIT     IEN1.1

	IP1		DATA	0B9H
	IRCON2		DATA	0BFH
	IRCON		DATA	0C0H
			TF2	BIT	IRCON.6
	T2CON		DATA	0C8H
	TRL2H		DATA	0CBH
	TRL2L		DATA	0CAH
	TH2		DATA	0CDH
	TL2		DATA	0CCH
		
	PSW		DATA	0D0H
		CY	BIT	PSW.7
		AC	BIT	PSW.6
		F0	BIT	PSW.5
		RS1	BIT	PSW.4
		RS0	BIT	PSW.3
		OV	BIT	PSW.2
		F1	BIT	PSW.1
		P	BIT	PSW.0
	ADCON		DATA	0D8H          
	ACC		DATA	0E0H
	B		DATA	0F0H

;***********************硬件扩展定义******************
	;DGUS变量存储器访问
	RAMMODE	DATA	0F8H
		APP_REQ	BIT	RAMMODE.7
		APP_EN	BIT	RAMMODE.6
		APP_RW	BIT	RAMMODE.5	;1=READ 0=WRITE
		APP_ACK	BIT	RAMMODE.4
	ADR_H	DATA	0F1H
	ADR_M	DATA	0F2H
	ADR_L	DATA	0F3H
	ADR_INC DATA	0F4H
	DATA3	DATA	0FAH
	DATA2	DATA	0FBH
	DATA1	DATA	0FCH
	DATA0	DATA	0FDH

	;UART4
	SCON2T		DATA	96H
	SCON2R		DATA	97H
	BODE2_DIV_H	DATA	0D9H
	BODE2_DIV_L	DATA	0E7H
	SBUF2_TX	DATA	9EH
	SBUF2_RX	DATA	9FH

	;UART5
	SCON3T		DATA	0A7H
	SCON3R		DATA	0ABH
	BODE3_DIV_H	DATA	0AEH
	BODE3_DIV_L	DATA	0AFH
	SBUF3_TX	DATA	0ACH
	SBUF3_RX	DATA	0ADH

	;CAN接口
	CAN_CR	DATA	08FH
	CAN_IR	DATA	091H
	CAN_ET	DATA	0E8H

	;GPIO
	P0MDOUT	DATA	0B7H
	P1MDOUT	DATA	0BCH
	P2MDOUT	DATA	0BDH
	P3MDOUT	DATA	0BEH
	MUX_SEL	DATA	0C9H
	PORTDRV	DATA	0F9H		;输出驱动强度

	;MAC&DIV
	MAC_MODE DATA	0E5H
	DIV_MODE DATA	0E6H

	;SFR扩展接口
	EXADR	DATA	0FEH
	EXDATA	DATA	0FFH 
        
        ;以下为宏定义的伪指令
        WDT_ON  MACRO                           ;WDT开启
                ORL     MUX_SEL,#02H
                ENDM

        WDT_OFF MACRO                           ;WDT关闭
                ANL     MUX_SEL,#0FDH
                ENDM

        WDT_RST MACRO                           ;WDT复位（喂狗）
                ORL     MUX_SEL,#01H
                ENDM